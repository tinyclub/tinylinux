/*
 * Common module linker script, always used when linking a module.
 * Archs are free to supply their own linker scripts.  ld will
 * combine them automatically.
 */

/* .data.foo are generated by gcc itself with -fdata-sections,
 * whereas double-dot sections (like .data..percpu) are generated
 * by kernel's magic macros.
 *
 * Since this script does not specify what to do with double-dot sections,
 * ld -r will coalesce all .data..foo input sections into one .data..foo
 * output section, all .data..bar input sections into one .data..bar
 * output section and so on. This is exactly what we want.
 *
 * Same goes for .text, .bss and .rodata. In case of .rodata, various
 * .rodata.foo sections are generated by gcc even without -fdata-sections
 */

SECTIONS {

	/* Coalesce sections produced by gcc -ffunction-sections */
	.text   0 : AT(0) { *(.text .text.[A-Za-z0-9_$^]*) }

	/* Coalesce sections produced by gcc -fdata-sections */
	.rodata 0 : AT(0) { *(.rodata .rodata.[A-Za-z0-9_$^]*) }
	.data   0 : AT(0) { *(.data .data.[A-Za-z0-9_$^]*) }
	.bss    0 : AT(0) { *(.bss .bss.[A-Za-z0-9_$^]*) }

	/DISCARD/ : { *(.discard) }
}
